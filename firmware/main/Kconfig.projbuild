## firmware/main/Kconfig.projbuild
```kconfig
menu "Joy-Con Bridge"

config JCB_WIFI_STA_SSID
    string "Config-Mode Wi-Fi STA SSID (empty => SoftAP)"
    default ""
    help
        If non-empty, Config Mode joins this existing network and serves the
        UI at http://joycon-bridge.local/ (mDNS) plus the DHCP IP. If empty,
        Config Mode brings up a SoftAP (FR-18). SoftAP is also the fallback
        when a STA join fails.

config JCB_WIFI_STA_PASS
    string "Config-Mode Wi-Fi STA password"
    default ""

config JCB_SOFTAP_SSID
    string "SoftAP SSID"
    default "joycon-bridge"

config JCB_SOFTAP_PASS
    string "SoftAP password (WPA2, >= 8 chars — NFR-9)"
    default "joyconbridge"

config JCB_STATUS_LED_ENABLE
    bool "Enable WS2812 status LED"
    default n
    help
        Enable the addressable WS2812 status LED driver. Disable this for
        boards that only have a power LED or do not have a WS2812 connected.

config JCB_STATUS_LED_GPIO
    int "WS2812 status LED GPIO"
    depends on JCB_STATUS_LED_ENABLE
    default 8

config JCB_TEST_PRO_CONTROLLERS
    bool "Accept Switch Pro/8BitDo controllers as virtual Joy-Con halves"
    default n
    help
        For hardware testing without Joy-Cons, assign the first accepted
        Switch Pro or 8BitDo controller to the virtual left half and the
        second to the virtual right half. Each controller contributes the
        stick and buttons associated with its assigned half.

config JCB_AB_XBOX_POSITION_DEFAULT
    bool "Default A/B/X/Y to Xbox label position (else Nintendo position)"
    default n

config JCB_OUTPUT_RATE_HZ
    int "Host report / merge tick rate (Hz) — NFR-2 floor is 100"
    default 250

endmenu
```
